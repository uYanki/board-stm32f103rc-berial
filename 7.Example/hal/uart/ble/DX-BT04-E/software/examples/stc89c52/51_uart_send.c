
//**** 声明 ********************************************************************
/*******************************************************************************
 * 下面来自互联开源程序，由深圳市大夏龙雀科技有限公司收集
 * 方便用户参考学习，本公司不提供任何技术支持
 * 程序仅供测试参考，不能应用在实际工程中，不一定能通过编译
 * 公司网站 http://www.szdx-smart.com/
 * 淘宝网址 https://shop184598174.taobao.com/?spm=a1z10.5-c-s.w12096189-21564973333.3.547b1176WCCDxR&scene=taobao_shop
*******************************************************************************/



/********************************************************************
* 文件名  ： 串口发送试验.c
* 描述    :  该文件实现通过串口把数据从单片机发送到电脑，通过串口调试助手显示出来。
***********************************************************************/

#include<reg52.h>
#include<intrins.h>

#define uchar unsigned char
#define uint  unsigned int


/********************************************************************
* 名称 : Com_Init()
* 功能 : 初始化串口程序，晶振11.0592, 波特率9600 * 输入 : 无
* 输出 : 无
***********************************************************************/
void Com_Init(void)
{
  TMOD = 0x20;
  PCON = 0x00;
  SCON = 0x50;
  TH1 = 0xFd;
  TL1 = 0xFd;
  TR1 = 1;
}

/********************************************************************
* 名称 : Main()
* 功能 : 主函数
* 输入 : 无
* 输出 : 无
***********************************************************************/
void Main(void)
{
  uchar i = 0;
  uchar code Buffer[] = "uart send";  //所要发送的数据
  uchar *p;
  
  Com_Init();
  //P2 = 0x00;  //直接无视
  p = Buffer;
  
  while(1){
    SBUF = *p;
    while(!TI){  //如果发送完毕，硬件会置位TI
      _nop_();   //此句似乎可以去掉
    }
    TI = 0;  //TI清零
    p++;
    if(*p == '\0')
      break;  //在每个字符串的最后，会有一个'\0'
  }
  
  while(1);
}
