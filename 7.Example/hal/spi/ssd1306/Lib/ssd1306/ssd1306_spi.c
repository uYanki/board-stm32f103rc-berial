/*OLED底层驱动
 *@采用列行式，分辨率为128*64
 *存放格式如下.
 *[0]0 1 2 3 ... 127
 *[1]0 1 2 3 ... 127
 *[2]0 1 2 3 ... 127
 *[3]0 1 2 3 ... 127
 *[4]0 1 2 3 ... 127
 *[5]0 1 2 3 ... 127
 *[6]0 1 2 3 ... 127
 *[7]0 1 2 3 ... 127
 */

#include "ssd1306_spi.h"

#define XLevelL    0x00
#define XLevelH    0x10
#define XLevel     ((XLevelH & 0x0F) * 16 + XLevelL)
#define Max_Column 128
#define Max_Row    64
#define Brightness 0xCF

#define X_WIDTH 128
#define Y_WIDTH 64
//======================================
const uint8_t F6x8[] =
    {
        0x00, 0x00, 0x00, 0x00, 0x00, 0x00,  // sp
        0x00, 0x00, 0x00, 0x2f, 0x00, 0x00,  // !
        0x00, 0x00, 0x07, 0x00, 0x07, 0x00,  // "
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        0x14, 0x14, 0x14, 0x14, 0x14, 0x14   // horiz lines
};

const uint8_t F16x16_Idx[] =
    {
        "测距离周长面积度高坡亩仪搜索卫星大小查记录删除系统值设单价公顷元询每电池压经纬°㎡型号版本剩余空间返回退出"};

const uint8_t F16x16[] =
    {
        0x10, 0x60, 0x02, 0x8C, 0x00, 0xFE, 0x02, 0xF2, 0x02, 0xFE, 0x00, 0xF8, 0x00, 0xFF, 0x00, 0x00,
        0x04, 0x04, 0x7E, 0x01, 0x80, 0x47, 0x30, 0x0F, 0x10, 0x27, 0x00, 0x47, 0x80, 0x7F, 0x00, 0x00,  // 测0,

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        0x00, 0x7C, 0x40, 0x40, 0x40, 0x40, 0x40, 0x7F, 0x40, 0x40, 0x40, 0x40, 0x40, 0xFC, 0x00, 0x00,  // 出52,

};
//======================================================
// 128X64I液晶底层驱动[8X16]字体库
// 设计者: powerint
// 描  述: [8X16]西文字符的字模数据 (纵向取模,字节倒序)
// !"#$%&'()*+,-./0123456789:;<=>?@ABCDEFGHIJKLMNOPQRSTUVWXYZ[\]^_`abcdefghijklmnopqrstuvwxyz{|}~
//======================================================
const uint8_t F8X16[] =
    {
        0x00, 0x00, 0x00, 0x00, 0x00, 0x00, 0x00, 0x00, 0x00, 0x00, 0x00, 0x00, 0x00, 0x00, 0x00, 0x00,  // 0
        0x00, 0x00, 0x00, 0xF8, 0x00, 0x00, 0x00, 0x00, 0x00, 0x00, 0x00, 0x33, 0x30, 0x00, 0x00, 0x00,  //! 1
        0x00, 0x10, 0x0C, 0x06, 0x10, 0x0C, 0x06, 0x00, 0x00, 0x00, 0x00, 0x00, 0x00, 0x00, 0x00, 0x00,  //"2
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        0x00, 0x06, 0x01, 0x01, 0x02, 0x02, 0x04, 0x04, 0x00, 0x00, 0x00, 0x00, 0x00, 0x00, 0x00, 0x00,  //~94

};
/* 生成实心菱形图标的16*16点阵*/
const uint8_t nonside[] =
    {
        0x00, 0x00, 0x80, 0xC0, 0xE0, 0xF0, 0xF8, 0xFC, 0xF8, 0xF0, 0xE0, 0xC0, 0x80, 0x00, 0x00, 0x00,
        0x00, 0x00, 0x00, 0x01, 0x03, 0x07, 0x0F, 0x1F, 0x0F, 0x07, 0x03, 0x01, 0x00, 0x00, 0x00, 0x00,  // ◆0,
};

void LCD_WrDat(uint8_t data)
{
    uint8_t i = 8;
    // LCD_CS=0;;
    LCD_DC_SET;
    LCD_SCL_CLR;
    // asm("nop");
    while (i--) {
        if (data & 0x80) {
            LCD_SDA_SET;
        } else {
            LCD_SDA_CLR;
        }
        LCD_SCL_SET;
        // asm("nop");;
        // asm("nop");
        LCD_SCL_CLR;
        data <<= 1;
    }
    // LCD_CS=1;
}
void LCD_WrCmd(uint8_t cmd)
{
    uint8_t i = 8;

    // LCD_CS=0;;
    LCD_DC_CLR;
    LCD_SCL_CLR;
    // asm("nop");
    while (i--) {
        if (cmd & 0x80) {
            LCD_SDA_SET;
        } else {
            LCD_SDA_CLR;
        }
        LCD_SCL_SET;
        // asm("nop");;
        // asm("nop");
        LCD_SCL_CLR;
        cmd <<= 1;
        ;
    }
    // LCD_CS=1;
}

/*设置起始地址
 *Y轴是按8格递进的，y轴0~63，只能按8格的倍数显示，
 *因为列行式只能按8个字节进行
 */
void LCD_Set_Pos(uint8_t x, uint8_t y)
{
    LCD_WrCmd(0xb0 + (y >> 3));
    LCD_WrCmd(((x & 0xf0) >> 4) | 0x10);
    LCD_WrCmd((x & 0x0f) | 0x01);
}
void LCD_Fill(uint8_t bmp_data)
{
    uint8_t y, x;

    for (y = 0; y < 8; y++) {
        LCD_WrCmd(0xb0 + y);
        LCD_WrCmd(0x01);
        LCD_WrCmd(0x10);
        for (x = 0; x < X_WIDTH; x++)
            LCD_WrDat(bmp_data);
    }
}
void LCD_CLS(void)
{
    uint8_t y, x;
    for (y = 0; y < 8; y++) {
        LCD_WrCmd(0xb0 + y);
        LCD_WrCmd(0x01);
        LCD_WrCmd(0x10);
        for (x = 0; x < X_WIDTH; x++)
            LCD_WrDat(0);
    }
}
// 清除一行0-63
void LCD_CLS_y(char y)
{
    uint8_t x;

    LCD_WrCmd(0xb0 + (y >> 3));
    LCD_WrCmd(0x01);
    LCD_WrCmd(0x10);
    for (x = 0; x < X_WIDTH; x++) {
        LCD_WrDat(0);
    }
}

// 清除一行上的一块区域y=0-63
void LCD_CLS_line_area(uint8_t start_x, uint8_t start_y, uint8_t width)
{
    uint8_t x;

    LCD_WrCmd(0xb0 + (start_y >> 3));
    LCD_WrCmd(0x01);
    LCD_WrCmd(0x10);
    for (x = start_x; x < width; x++) {
        LCD_WrDat(0);
    }
}

void LCD_DLY_ms(uint16_t ms)
{
    uint16_t a;
    while (ms) {
        a = 1335;
        while (a--)
            ;
        ms--;
    }
    return;
}

void LCD_Init(void)
{
    // DDRA=0XFF;

    LCD_SCL_SET;
    // LCD_CS=1;	//预制SLK和SS为高电平

    LCD_RST_CLR;
    LCD_DLY_ms(50);
    LCD_RST_SET;

    LCD_WrCmd(0xae);  //--turn off oled panel
    LCD_WrCmd(0x00);  //---set low column address
    LCD_WrCmd(0x10);  //---set high column address
    LCD_WrCmd(0x40);  //--set start line address  Set Mapping RAM Display Start Line (0x00~0x3F)
    LCD_WrCmd(0x81);  //--set contrast control register
    LCD_WrCmd(0xcf);  // Set SEG Output Current Brightness
    LCD_WrCmd(0xa1);  //--Set SEG/Column Mapping     0xa0左右反置 0xa1正常
    LCD_WrCmd(0xc8);  // Set COM/Row Scan Direction   0xc0上下反置 0xc8正常
    LCD_WrCmd(0xa6);  //--set normal display
    LCD_WrCmd(0xa8);  //--set multiplex ratio(1 to 64)
    LCD_WrCmd(0x3f);  //--1/64 duty
    LCD_WrCmd(0xd3);  //-set display offset	Shift Mapping RAM Counter (0x00~0x3F)
    LCD_WrCmd(0x00);  //-not offset
    LCD_WrCmd(0xd5);  //--set display clock divide ratio/oscillator frequency
    LCD_WrCmd(0x80);  //--set divide ratio, Set Clock as 100 Frames/Sec
    LCD_WrCmd(0xd9);  //--set pre-charge period
    LCD_WrCmd(0xf1);  // Set Pre-Charge as 15 Clocks & Discharge as 1 Clock
    LCD_WrCmd(0xda);  //--set com pins hardware configuration
    LCD_WrCmd(0x12);
    LCD_WrCmd(0xdb);  //--set vcomh
    LCD_WrCmd(0x40);  // Set VCOM Deselect Level
    LCD_WrCmd(0x20);  //-Set Page Addressing Mode (0x00/0x01/0x02)
    LCD_WrCmd(0x02);  //
    LCD_WrCmd(0x8d);  //--set Charge Pump enable/disable
    LCD_WrCmd(0x14);  //--set(0x10) disable
    LCD_WrCmd(0xa4);  // Disable Entire Display On (0xa4/0xa5)
    LCD_WrCmd(0xa6);  // Disable Inverse Display On (0xa6/a7)
    LCD_WrCmd(0xaf);  //--turn on oled panel
    LCD_Fill(0x00);   // 初始清屏
    LCD_Set_Pos(0, 0);
}
//==============================================================
// 函数名： void LCD_PutPixel(uint8_t x,uint8_t y)
// 功能描述：绘制一个点（x,y）
// 参数：真实坐标值(x,y),x的范围0～127，y的范围0～64
// 返回：无
//==============================================================
void LCD_PutPixel(uint8_t x, uint8_t y)
{
    uint8_t data1;  // data1当前点的数据

    // LCD_Set_Pos(x,y);
    data1 = 0x01 << (y % 8);
    LCD_WrCmd(0xb0 + (y >> 3));
    LCD_WrCmd(((x & 0xf0) >> 4) | 0x10);
    LCD_WrCmd((x & 0x0f) | 0x00);
    LCD_WrDat(data1);
}
//==============================================================
// 函数名： void LCD_Put_Column(uint8_t x,uint8_t y,uint8_t data)
// 功能描述：操作一列显示，一列全显示0XFF,清除一列0X00;
// 参数：真实坐标值(x,y),x的范围0～127，y的范围0～64
// 返回：无
//==============================================================
void LCD_Put_Column(uint8_t x, uint8_t y, uint8_t data)
{
    LCD_WrCmd(0xb0 + (y >> 3));
    LCD_WrCmd(((x & 0xf0) >> 4) | 0x10);
    LCD_WrCmd((x & 0x0f) | 0x00);
    LCD_WrDat(data);
}

//==============================================================
// 函数名： void LCD_Rectangle(uint8_t x1,uint8_t y1,
//                   uint8_t x2,uint8_t y2,uint8_t color,uint8_t gif)
// 功能描述：绘制一个实心矩形
// 参数：左上角坐标（x1,y1）,右下角坐标（x2，y2）
//      其中x1、x2的范围0～127，y1，y2的范围0～63，即真实坐标值
// 返回：无
//==============================================================
void LCD_Rectangle(uint8_t x1, uint8_t y1, uint8_t x2, uint8_t y2, uint8_t gif)
{
    uint8_t n;

    LCD_Set_Pos(x1, y1 >> 3);
    for (n = x1; n <= x2; n++) {
        LCD_WrDat(0x01 << (y1 % 8));
        if (gif == 1) LCD_DLY_ms(50);
    }
    LCD_Set_Pos(x1, y2 >> 3);
    for (n = x1; n <= x2; n++) {
        LCD_WrDat(0x01 << (y2 % 8));
        if (gif == 1) LCD_DLY_ms(5);
    }
}
//==============================================================
// 函数名：LCD_P6x8Str(uint8_t x,uint8_t y,uint8_t *p)
// 功能描述：写入一组标准ASCII字符串
// 参数：显示的位置（x,y），y为页范围0～7，要显示的字符串
// 返回：无
//==============================================================
void LCD_P6x8Str(uint8_t x, uint8_t y, uint8_t* ch, const uint8_t* F6x8)
{
    uint8_t c = 0, i = 0, j = 0;

    while (*(ch + j) != '\0') {
        c = *(ch + j) - 32;
        if (x > 126) {
            x = 0;
            y++;
        }
        LCD_Set_Pos(x, y);
        for (i = 0; i < 6; i++) {
            LCD_WrDat(*(F6x8 + c * 6 + i));
        }
        x += 6;
        j++;
    }
}
//==============================================================
// 函数名：LCD_P8x16Str(uint8_t x,uint8_t y,uint8_t *p)
// 功能描述：写入一组标准ASCII字符串
// 参数：显示的位置（x,y），y为页范围0～63，要显示的字符串
// 返回：无
//==============================================================
void LCD_P8x16Str(uint8_t x, uint8_t y, uint8_t* ch, const uint8_t* F8x16)
{
    uint8_t c = 0, i = 0, j = 0;

    while (*(ch + j) != '\0') {
        c = *(ch + j) - 32;
        if (x > 120) {
            x = 0;
            y++;
        }
        LCD_Set_Pos(x, y);
        for (i = 0; i < 8; i++) {
            LCD_WrDat(*(F8x16 + c * 16 + i));
        }
        LCD_Set_Pos(x, y + 8);
        for (i = 0; i < 8; i++) {
            LCD_WrDat(*(F8x16 + c * 16 + i + 8));
        }
        x += 8;
        j++;
    }
}
// 输出汉字字符串
void LCD_P14x16Str(uint8_t x, uint8_t y, uint8_t ch[], const uint8_t* F14x16_Idx, const uint8_t* F14x16)
{
    uint8_t  wm = 0, ii = 0;
    uint16_t adder = 1;

    while (ch[ii] != '\0') {
        wm    = 0;
        adder = 1;
        while (*(F14x16_Idx + wm) > 127) {
            if (*(F14x16_Idx + wm) == ch[ii]) {
                if (*(F14x16_Idx + wm + 1) == ch[ii + 1]) {
                    adder = wm * 14;
                    break;
                }
            }
            wm += 2;
        }
        if (x > 118) {
            x = 0;
            y++;
        }
        LCD_Set_Pos(x, y);
        if (adder != 1)  // 显示汉字
        {
            LCD_Set_Pos(x, y);
            for (wm = 0; wm < 14; wm++) {
                LCD_WrDat(*(F14x16 + adder));
                adder += 1;
            }
            LCD_Set_Pos(x, y + 1);
            for (wm = 0; wm < 14; wm++) {
                LCD_WrDat(*(F14x16 + adder));
                adder += 1;
            }
        } else  // 显示空白字符
        {
            ii += 1;
            LCD_Set_Pos(x, y);
            for (wm = 0; wm < 16; wm++) {
                LCD_WrDat(0);
            }
            LCD_Set_Pos(x, y + 1);
            for (wm = 0; wm < 16; wm++) {
                LCD_WrDat(0);
            }
        }
        x += 14;
        ii += 2;
    }
}
// 输出汉字字符串
void LCD_P16x16Str(uint8_t x, uint8_t y, uint8_t* ch, const uint8_t* F16x16_Idx, const uint8_t* F16x16)
{
    uint8_t  wm = 0, ii = 0;
    uint16_t adder = 1;

    while (*(ch + ii) != '\0') {
        wm    = 0;
        adder = 1;
        while (*(F16x16_Idx + wm) > 127) {
            if (*(F16x16_Idx + wm) == *(ch + ii)) {
                if (*(F16x16_Idx + wm + 1) == *(ch + ii + 1)) {
                    adder = wm * 16;
                    break;
                }
            }
            wm += 2;
        }
        if (x > 118) {
            x = 0;
            y++;
        }
        LCD_Set_Pos(x, y);
        if (adder != 1)  // 显示汉字
        {
            LCD_Set_Pos(x, y);
            for (wm = 0; wm < 16; wm++) {
                LCD_WrDat(*(F16x16 + adder));
                adder += 1;
            }
            LCD_Set_Pos(x, y + 8);
            for (wm = 0; wm < 16; wm++) {
                LCD_WrDat(*(F16x16 + adder));
                adder += 1;
            }
        } else  // 显示空白字符
        {
            ii += 1;
            LCD_Set_Pos(x, y);
            for (wm = 0; wm < 16; wm++) {
                LCD_WrDat(0);
            }
            LCD_Set_Pos(x, y + 1);
            for (wm = 0; wm < 16; wm++) {
                LCD_WrDat(0);
            }
        }
        x += 16;
        ii += 2;
    }
}

/*输出汉字和字符混合字符串
 *Y轴是按8格递进的，y轴0~63，只能按8格的倍数显示，
 *因为列行式只能按8个字节进行
 *
 */

void LCD_Print(uint8_t x, uint8_t y, uint8_t* ch, uint8_t char_size, uint8_t ascii_size)
{
    uint8_t ch2[3];
    uint8_t ii = 0;
    while (*(ch + ii) != '\0') {
        if (*(ch + ii) > 127)  // 大于127为中文，小于等于127为ASCII
        {
            ch2[0] = *(ch + ii);
            ch2[1] = *(ch + ii + 1);
            ch2[2] = '\0';                                 // 汉字为两个字节
            LCD_P16x16Str(x, y, ch2, F16x16_Idx, F16x16);  // 显示汉字
            x += 16;
            ii += 2;
        } else {
            ch2[0] = *(ch + ii);
            ch2[1] = '\0';  // 字母占一个字节
            if (TYPE8X16 == ascii_size) {
                LCD_P8x16Str(x, y, ch2, F8X16);  // 显示字母
                x += 8;
            } else if (TYPE6X8 == ascii_size) {
                LCD_P6x8Str(x, y, ch2, F6x8);  // 显示字母
                x += 6;
            }

            ii += 1;
        }
    }
}

//==============================================================
// 函数名： void Draw_BMP(uint8_t x,uint8_t y)
// 功能描述：显示BMP图片128×64
// 参数：起始点坐标(x,y),x的范围0～127，y为页的范围0～63
// 返回：无
//==============================================================
void Draw_BMP(uint8_t x, uint8_t y, const uint8_t* bmp)
{
    uint8_t wm    = 0;
    uint8_t adder = 0;

    LCD_Set_Pos(x, y);
    for (wm = 0; wm < 16; wm++) {
        LCD_WrDat(*(bmp + adder));
        adder += 1;
    }
    LCD_Set_Pos(x, y + 8);
    for (wm = 0; wm < 16; wm++) {
        LCD_WrDat(*(bmp + adder));
        adder += 1;
    }
    /* u32 ii=0;
     uint8_t x,y;

     if(y1%8==0) y=y1/8;
     else y=y1/8+1;
           for(y=y0;y<=y1;y++)
           {
                   LCD_Set_Pos(x0,y);
       for(x=x0;x<x1;x++)
               {
                   LCD_WrDat(bmp[ii++]);
               }
           }	*/
}
