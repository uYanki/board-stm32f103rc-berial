/*
Arduino-MAX30100 oximetry / heart rate integrated sensor library
Copyright (C) 2016  OXullo Intersecans <x@brainrapers.org>

This program is free software: you can redistribute it and/or modify
it under the terms of the GNU General Public License as published by
the Free Software Foundation, either version 3 of the License, or
(at your option) any later version.

This program is distributed in the hope that it will be useful,
but WITHOUT ANY WARRANTY; without even the implied warranty of
MERCHANTABILITY or FITNESS FOR A PARTICULAR PURPOSE.  See the
GNU General Public License for more details.

You should have received a copy of the GNU General Public License
along with this program.  If not, see <http://www.gnu.org/licenses/>.
*/

#include <Wire.h>
#include "MAX30100_PulseOximeter.h"
#include <DFRobot_SSD1306_I2C.h>

#define REPORTING_PERIOD_MS     1000

// 动态变量
volatile float mind_n_bmpStatus, mind_n_spO2Status, mind_n_BMP, mind_n_SpO2;
// 函数声明
void DF_beep();
// 静态常量
const chCode chBuf[] = {
  {0x5fc3,0xe5bf83,0xD0C4,{0x00,0x00,0x00,0x00,0x01,0x00,0x01,0x80,0x08,0x80,0x28,0x98,0x68,0x08,0x48,0x0c,0x48,0x04,0x48,0x04,0x48,0x10,0x08,0x10,0x08,0x10,0x07,0xe0,0x00,0x00,0x00,0x00}},
  {0x7387,0xe78e87,0xC2CA,{0x00,0x00,0x01,0x00,0x7f,0xfc,0x02,0x00,0x64,0x4c,0x2f,0x90,0x03,0x00,0x1e,0x50,0x7f,0xec,0x41,0x24,0x01,0x00,0xff,0xfe,0x01,0x00,0x01,0x00,0x00,0x00,0x00,0x00}},
  {0x8840,0xe8a180,0xD1AA,{0x00,0x00,0x02,0x00,0x02,0x00,0x3f,0xf8,0x24,0x48,0x24,0x48,0x24,0x48,0x24,0x48,0x24,0x48,0x24,0x48,0x24,0x48,0x24,0x48,0x24,0x48,0xff,0xfe,0x00,0x00,0x00,0x00}},
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  {0xff01,0xefbc81,0xA3A1,{0x00,0x00,0x10,0x00,0x10,0x00,0x10,0x00,0x10,0x00,0x10,0x00,0x10,0x00,0x10,0x00,0x10,0x00,0x10,0x00,0x00,0x00,0x00,0x00,0x10,0x00,0x10,0x00,0x00,0x00,0x00,0x00}}
};
// 创建对象
DFRobot_SSD1306_I2C oled12864;

// PulseOximeter is the higher level interface to the sensor
// it offers:
//  * beat detection reporting
//  * heart rate calculation
//  * SpO2 (oxidation level) calculation
PulseOximeter pox;

uint32_t tsLastReport = 0;

// Callback (registered below) fired when a pulse is detected
void onBeatDetected()
{
    Serial.println("Beat!");
}

void setup()
{
  pinMode(4,OUTPUT);
  pinMode(5,OUTPUT);
  pinMode(6,OUTPUT);
  pinMode(11,OUTPUT);

  Serial.begin(9600);
  Serial.print("Initializing pulse oximeter..");
  
  oled12864.begin(0x3c);
  oled12864.setChCode(chBuf);
  digitalWrite(4, LOW);
  analogWrite(5, 10);
  analogWrite(6, 0);
  DF_beep();
  oled12864.setRotaion(eROTATION_0);
  oled12864.setCursor(0, 0);
  oled12864.print("Initializing");
  oled12864.setCursor(0, 1);
  oled12864.print("心率:");
  oled12864.setCursor(0, 2);
  oled12864.print("血氧:");
  oled12864.setCursor(16, 3);
  oled12864.print(" ~请按手指~ ");
  oled12864.setCursor(16, 3);
  oled12864.print("");
  
    // Initialize the PulseOximeter instance
    // Failures are generally due to an improper I2C wiring, missing power supply
    // or wrong target chip
    if (!pox.begin()) {
        Serial.println("FAILED");
    oled12864.setCursor(0, 0);
    oled12864.print("Initial FAILED");
        for(;;);
    } else {
        Serial.println("SUCCESS");
    oled12864.setCursor(0, 0);
    oled12864.print("Initial SUCCESS");
    } 
  oled12864.setCursor(0, 0);
  oled12864.print("  心率血氧测试 ");
    // The default current for the IR LED is 50mA and it could be changed
    //   by uncommenting the following line. Check MAX30100_Registers.h for all the
    //   available options.
    // pox.setIRLedCurrent(MAX30100_LED_CURR_7_6MA);

    // Register a callback for the beat detection
    pox.setOnBeatDetectedCallback(onBeatDetected);
}

void loop()
{
    // Make sure to call update as fast as possible
    pox.update();

    // Asynchronously dump heart rate and oxidation levels to the serial
    // For both, a value of 0 means "invalid"
    if (millis() - tsLastReport > REPORTING_PERIOD_MS) {
        mind_n_BMP = pox.getHeartRate();
        mind_n_SpO2 = pox.getSpO2();
        Serial.print("Heart rate:");
        Serial.print(mind_n_BMP);
        Serial.print("bpm / SpO2:");
        Serial.print(mind_n_SpO2);
        Serial.println("%");

    if ((mind_n_BMP<100)) {
        oled12864.setCursor(48, 1);
        oled12864.print((String("0") + String((String(mind_n_BMP).toInt()))));
        }
        else {
          oled12864.setCursor(48, 1);
          oled12864.print((String(mind_n_BMP).toInt()));
        }
        oled12864.setCursor(80, 1);
        oled12864.print("bpm");
        
    if ((mind_n_SpO2<100)) {
          oled12864.setCursor(48, 2);
          oled12864.print((String("0") + String((String(mind_n_SpO2).toInt()))));
        }
        else {
          oled12864.setCursor(48, 2);
          oled12864.print((String(mind_n_SpO2).toInt()));
        }
        oled12864.setCursor(80, 2);
        oled12864.print("%");

    if ((mind_n_BMP<30)) {
          mind_n_bmpStatus = 0;
        }
        else if (((mind_n_BMP<50) || (mind_n_BMP>100))) {
          mind_n_bmpStatus = 1;
        }
        else {
          mind_n_bmpStatus = 2;
        }
        
        if ((mind_n_SpO2<30)) {
          mind_n_spO2Status = 0;
        }
        else if ((mind_n_SpO2<90)) {
          mind_n_spO2Status = 1;
        }
        else {
          mind_n_spO2Status = 2;
        }
    
    if (((mind_n_BMP==0) || (mind_n_SpO2==0))) {
          oled12864.setCursor(16, 3);
          oled12864.print(" ~请按手指~ ");
        }
        else if (((mind_n_BMP==1) || (mind_n_SpO2==1))) {
          analogWrite(5, 0);
          analogWrite(6, 10);       
          oled12864.setCursor(16, 3);
          oled12864.print("！！危险！！");
        }
        else {
          analogWrite(5, 10);
          analogWrite(6, 0);
          oled12864.setCursor(16, 3);
          oled12864.print("~~~~安全~~~~");
        }
        
       tsLastReport = millis();
    }
}

// 自定义函数
void DF_beep() {
  digitalWrite(11, HIGH);
  delay(100);
  digitalWrite(11, LOW);
  delay(100);
}
