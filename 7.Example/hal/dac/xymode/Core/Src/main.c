/* USER CODE BEGIN Header */
/**
 ******************************************************************************
 * @file           : main.c
 * @brief          : Main program body
 ******************************************************************************
 * @attention
 *
 * <h2><center>&copy; Copyright (c) 2022 STMicroelectronics.
 * All rights reserved.</center></h2>
 *
 * This software component is licensed by ST under BSD 3-Clause license,
 * the "License"; You may not use this file except in compliance with the
 * License. You may obtain a copy of the License at:
 *                        opensource.org/licenses/BSD-3-Clause
 *
 ******************************************************************************
 */
/* USER CODE END Header */
/* Includes ------------------------------------------------------------------*/
#include "main.h"
#include "dac.h"
#include "gpio.h"

/* Private includes ----------------------------------------------------------*/
/* USER CODE BEGIN Includes */

/* USER CODE END Includes */

/* Private typedef -----------------------------------------------------------*/
/* USER CODE BEGIN PTD */

/* USER CODE END PTD */

/* Private define ------------------------------------------------------------*/
/* USER CODE BEGIN PD */

/* USER CODE END PD */

/* Private macro -------------------------------------------------------------*/
/* USER CODE BEGIN PM */

/* USER CODE END PM */

/* Private variables ---------------------------------------------------------*/

/* USER CODE BEGIN PV */

/* USER CODE END PV */

/* Private function prototypes -----------------------------------------------*/
void SystemClock_Config(void);
/* USER CODE BEGIN PFP */

/* USER CODE END PFP */

/* Private user code ---------------------------------------------------------*/
/* USER CODE BEGIN 0 */

#if 0

// string

static const uint8_t xs[] = {
    2, 2, 22, 22, 2, 22,                     // R
    27, 48, 48, 27, 27, 27, 48, 48, 27, 48,  // 2
    52, 52, 73, 73, 52, 73, 73,              // A
    85, 77, 77, 77, 85, 91, 98, 98, 98, 91,  // U
    102, 102, 102, 123, 102, 123,            // K
};
static const uint8_t ys[] = {
    42, 84, 84, 63, 63, 42,                  // R
    42, 63, 84, 84, 63, 84, 84, 63, 42, 42,  // 2
    42, 84, 84, 63, 63, 63, 42,              // A
    42, 50, 84, 50, 42, 42, 50, 84, 50, 42,  // U
    42, 84, 63, 84, 63, 42,                  // K
};

int16_t idx       = 0;
int16_t prev_idx  = 0;
uint8_t curr_x    = 0;
uint8_t curr_y    = 0;
int16_t dx        = 0;
int16_t dy        = 0;
int8_t  direction = 1;

void next_line()
{
    const uint8_t speed          = 32;
    int8_t        next_direction = direction;
    idx += direction;
    if (idx < 0) {
        idx            = 0;
        next_direction = -direction;
    } else if (idx >= sizeof(xs) / sizeof(xs[0])) {
        idx            = sizeof(xs) / sizeof(xs[0]) - 1;
        next_direction = -direction;
    }

    prev_idx = idx - direction;
    if (prev_idx < 0) {
        prev_idx = sizeof(xs) / sizeof(xs[0]) - 1;
    } else if (prev_idx >= sizeof(xs) / sizeof(xs[0])) {
        prev_idx = 0;
    }

    direction = next_direction;
    curr_x    = xs[prev_idx];
    curr_y    = ys[prev_idx];

    dx        = (((int16_t)xs[idx]) - ((int16_t)xs[prev_idx])) / speed;
    dy        = (((int16_t)ys[idx]) - ((int16_t)ys[prev_idx])) / speed;
    if (dx == 0) {
        if (xs[idx] > xs[prev_idx]) {
            dx = 1;
        } else if (xs[idx] < xs[prev_idx]) {
            dx = -1;
        }
    }

    if (dy == 0) {
        if (ys[idx] > ys[prev_idx]) {
            dy = 1;
        } else if (ys[idx] < ys[prev_idx]) {
            dy = -1;
        }
    }
}

void init()
{
    HAL_DAC_Start(&hdac, DAC_CHANNEL_1);
    HAL_DAC_Start(&hdac, DAC_CHANNEL_2);
    next_line();
    HAL_Delay(1);
}

void loop()
{
    curr_x += dx;
    curr_y += dy;
    if (((dx > 0) && (curr_x > xs[idx])) ||
        ((dx < 0) && (curr_x < xs[idx]))) {
        curr_x = xs[idx];
    }
    if (((dy > 0) && (curr_y > ys[idx])) ||
        ((dy < 0) && (curr_y < ys[idx]))) {
        curr_y = ys[idx];
    }

    uint32_t x = ((uint32_t)curr_x) * 0xFFF / 128;
    uint32_t y = ((uint32_t)curr_y) * 0xFFF / 128;
    HAL_DAC_SetValue(&hdac, DAC_CHANNEL_1, DAC_ALIGN_12B_R, x);
    HAL_DAC_SetValue(&hdac, DAC_CHANNEL_2, DAC_ALIGN_12B_R, y);

    if ((curr_x == xs[idx]) && (curr_y == ys[idx])) {
        next_line();
    }

    HAL_Delay(10);
}

#else

// image

#define ARRAY_SIZE(arr) (sizeof(arr) / sizeof(arr[0]))

static const uint16_t img[3832] = {
    976, 3147, 995, 3147, 1013, 3147, 1032, 3147, 1050, 3147,
    1069, 3147, 1087, 3147, 1105, 3147, 1124, 3147, 1142, 3147,
    1161, 3147, 1179, 3147, 1198, 3147, 1216, 3147, 1235, 3147,
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    3981, 49};

void init()
{
    HAL_DAC_Start(&hdac, DAC_CHANNEL_1);
    HAL_DAC_Start(&hdac, DAC_CHANNEL_2);
}

void loop()
{
    uint32_t i = 0;
    while (i < ARRAY_SIZE(img)) {
        DAC1->DHR12R1 = img[i++];
        DAC1->DHR12R2 = img[i++];
        HAL_Delay(8);  // 8us (自定)
    }
}

#endif

/* USER CODE END 0 */

/**
 * @brief  The application entry point.
 * @retval int
 */
int main(void)
{
    /* USER CODE BEGIN 1 */

    /* USER CODE END 1 */

    /* MCU Configuration--------------------------------------------------------*/

    /* Reset of all peripherals, Initializes the Flash interface and the Systick. */
    HAL_Init();

    /* USER CODE BEGIN Init */

    /* USER CODE END Init */

    /* Configure the system clock */
    SystemClock_Config();

    /* USER CODE BEGIN SysInit */

    /* USER CODE END SysInit */

    /* Initialize all configured peripherals */
    MX_GPIO_Init();
    MX_DAC_Init();
    /* USER CODE BEGIN 2 */
    init();
    /* USER CODE END 2 */

    /* Infinite loop */
    HAL_SYSTICK_Config(HAL_RCC_GetHCLKFreq() / 1e6);  // us
    /* USER CODE BEGIN WHILE */
    while (1) {
        loop();
        /* USER CODE END WHILE */

        /* USER CODE BEGIN 3 */
    }
    /* USER CODE END 3 */
}

/**
 * @brief System Clock Configuration
 * @retval None
 */
void SystemClock_Config(void)
{
    RCC_OscInitTypeDef RCC_OscInitStruct = {0};
    RCC_ClkInitTypeDef RCC_ClkInitStruct = {0};

    /** Initializes the RCC Oscillators according to the specified parameters
     * in the RCC_OscInitTypeDef structure.
     */
    RCC_OscInitStruct.OscillatorType     = RCC_OSCILLATORTYPE_HSE;
    RCC_OscInitStruct.HSEState           = RCC_HSE_ON;
    RCC_OscInitStruct.HSEPredivValue     = RCC_HSE_PREDIV_DIV1;
    RCC_OscInitStruct.HSIState           = RCC_HSI_ON;
    RCC_OscInitStruct.PLL.PLLState       = RCC_PLL_ON;
    RCC_OscInitStruct.PLL.PLLSource      = RCC_PLLSOURCE_HSE;
    RCC_OscInitStruct.PLL.PLLMUL         = RCC_PLL_MUL9;
    if (HAL_RCC_OscConfig(&RCC_OscInitStruct) != HAL_OK) {
        Error_Handler();
    }

    /** Initializes the CPU, AHB and APB buses clocks
     */
    RCC_ClkInitStruct.ClockType      = RCC_CLOCKTYPE_HCLK | RCC_CLOCKTYPE_SYSCLK | RCC_CLOCKTYPE_PCLK1 | RCC_CLOCKTYPE_PCLK2;
    RCC_ClkInitStruct.SYSCLKSource   = RCC_SYSCLKSOURCE_PLLCLK;
    RCC_ClkInitStruct.AHBCLKDivider  = RCC_SYSCLK_DIV1;
    RCC_ClkInitStruct.APB1CLKDivider = RCC_HCLK_DIV2;
    RCC_ClkInitStruct.APB2CLKDivider = RCC_HCLK_DIV1;

    if (HAL_RCC_ClockConfig(&RCC_ClkInitStruct, FLASH_LATENCY_2) != HAL_OK) {
        Error_Handler();
    }
}

/* USER CODE BEGIN 4 */

/* USER CODE END 4 */

/**
 * @brief  This function is executed in case of error occurrence.
 * @retval None
 */
void Error_Handler(void)
{
    /* USER CODE BEGIN Error_Handler_Debug */
    /* User can add his own implementation to report the HAL error return state */

    /* USER CODE END Error_Handler_Debug */
}

#ifdef USE_FULL_ASSERT
/**
 * @brief  Reports the name of the source file and the source line number
 *         where the assert_param error has occurred.
 * @param  file: pointer to the source file name
 * @param  line: assert_param error line source number
 * @retval None
 */
void assert_failed(uint8_t* file, uint32_t line)
{
    /* USER CODE BEGIN 6 */
    /* User can add his own implementation to report the file name and line number,
       tex: printf("Wrong parameters value: file %s on line %d\r\n", file, line) */
    /* USER CODE END 6 */
}
#endif /* USE_FULL_ASSERT */
